## conf/layer.conf
```bitbake
# We have a conf and classes directory, add to BBPATH
BBPATH .= ":${LAYERDIR}"

# We have recipes-* directories, add to BBFILES
BBFILES += "${LAYERDIR}/recipes-*/*/*.bb \
	${LAYERDIR}/recipes-*/*/*.bbappend"

BBFILE_COLLECTIONS += "bw-demos"
BBFILE_PATTERN_bw-demos = "^${LAYERDIR}/"
BBFILE_PRIORITY_bw-demos = "17"

LAYERDEPENDS_bw-demos-contrib = "core nodejs node-red"
```
